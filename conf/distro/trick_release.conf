## conf/distro/trick_release.conf
```bitbake
#@--------------------------------------------------------------------
#@TYPE: Distribution
#@NAME: TrickBot  
#@DESCRIPTION: The Linux Distribution for Trick board devices
#@MAINTAINER: Roman Meshkevich
#@--------------------------------------------------------------------
DISTRO_VERSION = "v_1.0"

DISTRO = "trickBot"

DISTRO_NAME = "trickBot"

#OLDEST_KERNEL = "2.6.16"

DISTRO_TYPE ?= "release"

IMAGE_LINGUAS ?= "en-us"
TRICK_GCC_VERSION                             ?= "4.7%"
TRICK_BINUTILS_VERSION                        ?= "2.22"
# QT 4
TRICK_QT_VERSION ?= "4.8.1"
PREFERRED_VERSION_qt4-native = "${TRICK_QT_VERSION}"
PREFERRED_VERSION_qt4-tools-native = "${TRICK_QT_VERSION}"
PREFERRED_VERSION_qt4-tools-nativesdk = "${TRICK_QT_VERSION}"
PREFERRED_VERSION_qt4-tools-sdk = "${TRICK_QT_VERSION}"
PREFERRED_VERSION_qt4-embedded = "${TRICK_QT_VERSION}"
PREFERRED_VERSION_qt4-embedded-gles = "${TRICK_QT_VERSION}"
PREFERRED_VERSION_qt4-x11-free = "${TRICK_QT_VERSION}"
PREFERRED_VERSION_qt4-x11-free-gles = "${TRICK_QT_VERSION}"
TARGET_VENDOR = "-trick"
SDK_VENDOR = "-tricksdk"
#SOC_FAMILY ?= ""
# Can be "glibc", "eglibc" or "uclibc"
TCLIBC ?= "eglibc"

# The things *libc can provide.
PREFERRED_PROVIDER_virtual/libc = "${TCLIBC}"
PREFERRED_PROVIDER_virtual/${TARGET_PREFIX}libc-initial = "${TCLIBC}-initial"
PREFERRED_PROVIDER_virtual/${TARGET_PREFIX}libc-for-gcc = "${TCLIBC}"

# And the same as above for the nativesdk
PREFERRED_PROVIDER_virtual/libc-nativesdk = "${TCLIBC}-nativesdk"
PREFERRED_PROVIDER_virtual/${SDK_PREFIX}libc-initial-nativesdk = "${TCLIBC}-initial-nativesdk"
PREFERRED_PROVIDER_virtual/${SDK_PREFIX}libc-for-gcc-nativesdk = "${TCLIBC}-nativesdk"

PREFERRED_PROVIDER_virtual/gettext ??= "gettext"
PREFERRED_PROVIDER_linux-libc-headers-nativesdk = "linux-libc-headers-nativesdk"

#require conf/distro/include/angstrom-${TCLIBC}.inc
ARM_INSTRUCTION_SET ?= "arm"

INHERIT += "debian"
INHERIT += "devshell"

TRICK_PKG_FORMAT ?= "ipk"
#require conf/distro/include/angstrom-package-${TRICK_PKG_FORMAT}.inc
DISTRO_FEATURES ="alsa bluetooth ext2 ipv4 ipv6  usbhost"
```

## conf/distro/trik_debug.conf
```bitbake
#@--------------------------------------------------------------------
#@TYPE: Distribution
#@NAME: TrikBot  
#@DESCRIPTION: The Linux Distribution for trikboard devices
#@MAINTAINER: Roman Meshkevich
#@--------------------------------------------------------------------
DISTRO_VERSION = "v_1.0"

DISTRO = "trikBot"

DISTRO_NAME = "trikBot"

#OLDEST_KERNEL = "2.6.16"

DISTRO_TYPE ?= "debug"

IMAGE_LINGUAS ?= "en-us"
TRIK_GCC_VERSION                             ?= "4.7%"
TRIK_BINUTILS_VERSION                        ?= "2.22"
# QT 4
TRIK_QT_VERSION ?= "4.8.1"
PREFERRED_VERSION_qt4-native = "${TRIK_QT_VERSION}"
PREFERRED_VERSION_qt4-tools-native = "${TRIK_QT_VERSION}"
PREFERRED_VERSION_qt4-tools-nativesdk = "${TRIK_QT_VERSION}"
PREFERRED_VERSION_qt4-tools-sdk = "${TRIK_QT_VERSION}"
PREFERRED_VERSION_qt4-embedded = "${TRIK_QT_VERSION}"
PREFERRED_VERSION_qt4-embedded-gles = "${TRIK_QT_VERSION}"
PREFERRED_VERSION_qt4-x11-free = "${TRIK_QT_VERSION}"
PREFERRED_VERSION_qt4-x11-free-gles = "${TRIK_QT_VERSION}"
TARGET_VENDOR = "-trik"
SDK_VENDOR = "-triksdk"
#SOC_FAMILY ?= ""
# Can be "glibc", "eglibc" or "uclibc"
TCLIBC ?= "eglibc"

# The things *libc can provide.
PREFERRED_PROVIDER_virtual/libc = "${TCLIBC}"
PREFERRED_PROVIDER_virtual/${TARGET_PREFIX}libc-initial = "${TCLIBC}-initial"
PREFERRED_PROVIDER_virtual/${TARGET_PREFIX}libc-for-gcc = "${TCLIBC}"

# And the same as above for the nativesdk
PREFERRED_PROVIDER_virtual/libc-nativesdk = "${TCLIBC}-nativesdk"
PREFERRED_PROVIDER_virtual/${SDK_PREFIX}libc-initial-nativesdk = "${TCLIBC}-initial-nativesdk"
PREFERRED_PROVIDER_virtual/${SDK_PREFIX}libc-for-gcc-nativesdk = "${TCLIBC}-nativesdk"

PREFERRED_PROVIDER_virtual/gettext ??= "gettext"
PREFERRED_PROVIDER_linux-libc-headers-nativesdk = "linux-libc-headers-nativesdk"

#require conf/distro/include/angstrom-${TCLIBC}.inc
ARM_INSTRUCTION_SET ?= "arm"

INHERIT += "debian"
INHERIT += "devshell"

TRIK_PKG_FORMAT ?= "ipk"
#require conf/distro/include/angstrom-package-${TRIK_PKG_FORMAT}.inc
DISTRO_FEATURES ="alsa bluetooth ext2 ipv4 ipv6  usbhost"
```

## conf/layer.conf
```bitbake
# We have a conf and classes directory, add to BBPATH
BBPATH .= ":${LAYERDIR}"
# We have a packages directory, add to BBFILES
BBFILES += "${LAYERDIR}/recipes-*/*/*.bb ${LAYERDIR}/recipes*/*/*.bbappend"

BBFILE_COLLECTIONS += "trik"
BBFILE_PATTERN_trik := "^${LAYERDIR}/"
BBFILE_PRIORITY_trik = "5"

# This should only be incremented on significant changes that will
# cause compatibility issues with other layers
LAYERVERSION_core = "1"

# Set a variable to get to the top of the metadata location
TRIKBASE := '${@os.path.normpath("${LAYERDIR}/../")}'

# Set path to qemu image tests included in this layer
#QEMUIMAGETESTS := "${COREBASE}/scripts/qemuimage-tests"

#SIGGEN_EXCLUDERECIPES_ABISAFE += " \
#  sysvinit-inittab \
#  shadow-securetty \
#  opkg-config-base \
#  netbase \
#  formfactor \
#  xserver-xf86-config \
#  pointercal \
#  base-files \
#  keymaps \
#  udev-extraconf \
#  packagegroup-x11-xserver \
#"
```

## conf/machine/trickr2e.conf
```bitbake
#@TYPE: Machine
#@NAME: Trick r2e
#@DESCRIPTION: Machine configuration for the OMAP L138 trick schematic revision r2e 
TARGET_ARCH = "arm"

require conf/machine/include/davinci.inc
require conf/machine/include/omapl138.inc

PREFERRED_PROVIDER_virtual/kernel = "linux-trick"
PREFERRED_PROVIDER_virtual/bootloader = "u-boot-trick"


#UBOOT_MACHINE = "trik_bootloader_config"
UBOOT_ENTRYPOINT = "0xc0008000"
UBOOT_LOADADDRESS = "0xc0008000"

EXTRA_IMAGEDEPENDS = "u-boot-trick"

MACHINE_FEATURES = "kernel26 serial usbhost usbgadget vfat mmc alsa ext2 ide screen wifi bluetooth"

MACHINE_FEATURES_BACKFILL_CONSIDERED = "rtc"

MACHINE_EXTRA_RRECOMMENDS += " \
        kernel-modules \
"

IMAGE_FSTYPES = "ext2 tar.bz2"

SERIAL_CONSOLE = "-L 115200 ttyS1"
USE_VT = "1"
SYSVINIT_ENABLED_GETTYS = "0"
```

## conf/machine/trikboard.conf
```bitbake
#@TYPE: Machine
#@NAME: Trikboard
#@DESCRIPTION: Machine configuration for the OMAP L138 trikboard schematic revision r2e 
TARGET_ARCH = "arm"

require include/davinci.inc
require include/omapl138.inc

PREFERRED_PROVIDER_virtual/kernel = "linux-trik"
PREFERRED_PROVIDER_virtual/bootloader = "u-boot-trik"


#UBOOT_MACHINE = "trik_bootloader_config"
UBOOT_ENTRYPOINT = "0xc0008000"
UBOOT_LOADADDRESS = "0xc0008000"

EXTRA_IMAGEDEPENDS = "u-boot-trik"

MACHINE_FEATURES = "kernel26 serial usbhost usbgadget vfat mmc alsa ext2 ide screen wifi bluetooth zeroconf"

MACHINE_FEATURES_BACKFILL_CONSIDERED = "rtc"

MACHINE_EXTRA_RRECOMMENDS += " \
        kernel-modules \
"

IMAGE_FSTYPES = "ext4 ext2 ext4.gz squashfs"

SERIAL_CONSOLE = "-L 115200 ttyS1"
USE_VT = "0"
SYSVINIT_ENABLED_GETTYS = "0"
```
